## boards/shields/non_nemo/Kconfig.defconfig
```kconfig
if SHIELD_NON_NEMO_DONGLE

config ZMK_KEYBOARD_NAME
    default "NON NEMO"

config ZMK_SPLIT_ROLE_CENTRAL
    default y

config ZMK_SPLIT_BLE_CENTRAL_PERIPHERALS
    default 2

# Set this to ZMK_SPLIT_BLE_CENTRAL_PERIPHERALS + your desired number of BT profiles (default is 5)
config BT_MAX_CONN
    default 7

# Set this to the same number as BT_MAX_CONN
config BT_MAX_PAIRED
    default 7

endif   # SHIELD_NON_NEMO_DONGLE


if SHIELD_NON_NEMO

config ZMK_SPLIT
    default y

endif # SHIELD_NON_NEMO
```

## boards/shields/non_nemo/Kconfig.shield
```kconfig
# Copyright (c) 2023 The ZMK Contributors
# SPDX-License-Identifier: MIT

config SHIELD_NON_NEMO_DONGLE
    def_bool $(shields_list_contains,non_nemo_dongle)

config SHIELD_NON_NEMO_LEFT
    def_bool $(shields_list_contains,non_nemo_left)

config SHIELD_NON_NEMO_RIGHT
    def_bool $(shields_list_contains,non_nemo_right)
```

## config/west.yml
```yaml
manifest:
  remotes:
    - name: zmkfirmware
      url-base: https://github.com/zmkfirmware
    # Additional modules containing boards/shields/custom code can be listed here as well
    # See https://docs.zephyrproject.org/3.2.0/develop/west/manifest.html#projects
    - name: urob
      url-base: https://github.com/urob
    # Prospector
    - name: carrefinho
      url-base: https://github.com/carrefinho
    # Dongle Screen
    - name: janpfischer
      url-base: https://github.com/janpfischer
    # TB2086
    - name: tb2086
      url-base: https://github.com/Thunderbird2086
  projects:
    - name: zmk
      remote: zmkfirmware
      revision: main
      import: app/west.yml
    - name: zmk-helpers
      remote: urob
      revision: main
    - name: prospector-zmk-module
      remote: carrefinho
      revision: main
      path: modules/prospector-zmk-module
    - name: zmk-dongle-screen
      remote: janpfischer
      revision: main
      path: modules/zmk-dongle-screen
  self:
    path: config
```
